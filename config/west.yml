## config/west.yml
```yaml
manifest:
  defaults:
    revision: main
  remotes:
    - name: zmkfirmware
      url-base: https://github.com/zmkfirmware
    - name: nicekeyboards
      url-base: https://github.com/nicekeyboards
  projects:
    - name: zmk
      remote: zmkfirmware
      import: app/west.yml
    - name: zmk-nice-nano
      remote: nicekeyboards
      revision: main
      import: zmk-nice-nano.yml
  self:
    path: config
```
